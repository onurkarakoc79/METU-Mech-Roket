#include <Wire.h>
#include <SPI.h>
#include <LoRa.h>
#include <Ch376msc.h>


/////////////////////////////////////////////////////////////////////////Timers Defines///////////////////////////////////////////////////////////////////////////////////////////


unsigned long GPRStimer=millis();



//////////////////////////////////////////////////////////////////////////TIMER DEFINES///////////////////////////////////////////////////////////////////////////////////////////





//////////////////////////////////////////////////////////////////////USB FLASH DISK DEFINES START////////////////////////////////////////////////////////////////////////////////


Ch376msc flashDrive(Serial2, 115200); // Ch376 object with hardware Serial2 on arduino mega baudrate: 9600, 19200, 57600, 115200
static char datafilename[]="deneme.TXT";


///////////////////////////////////////////////////////////////////////USB FLASH DISK DEFINES ENDS////////////////////////////////////////////////////////////////////////////////






//////////////////////////////////////////////////////////////////////SERIAL COMMUNICATON DEFINES START///////////////////////////////////////////////////////////////////////////


static const uint32_t DUEBaud=9600;
char c="";
String message;
String fmessage;
const int messagelength=300;
char messagearray[messagelength];
char termChar='#';
bool haveNewData=false;


////////////////////////////////////////////////////////////////////////SERIAL COMMMUNICATION DEFINES END/////////////////////////////////////////////////////////////////////////






//////////////////////////////////////////////////////////////////////////////LORA DEFINES STARTS////////////////////////////////////////////////////////////////////////////////

bool loraStatus=true;

///////////////////////////////////////////////////////////////////////////////LORA DEFINES ENDS/////////////////////////////////////////////////////////////////////////////////









void setup() {
  // put your setup code here, to run once:
  Serial.begin(9600);
  Serial1.begin(DUEBaud);//GPRS
  
  //Serial3.begin(SATCOMBaud);
  
  flashDriveBegin(datafilename);
  //LoRaBegin(-1,-1);
  
}

void loop() {
  // put your main code here, to run repeatedly:
  
  
  readMessages();
  if(haveNewData){
    fmessage.toCharArray(messagearray,messagelength);
    if(checkFlashDrive()){
      flashWriteToFile(datafilename,messagearray);
    }
    Serial.print(fmessage);
    haveNewData=false;
  }

  if(delayTimes(&GPRStimer,100000)){
    //GPRS çalışsın
    Serial.println("GPRS message sended");
    
  }
 
 
  
  /*SAKIN DELAY ATMA SIÇARIM AĞZINA*/
  
}









//////////////////////////////////////////////////////////////////////SERIAL COMMUNICATION FUNCTIONS START////////////////////////////////////////////////////////////////////////


void readMessages(){
  
  if(Serial1.available()){
     c=Serial1.read();
     if(c!=termChar){
        message+=c;
     }
     else{
      fmessage=message;
      message="";
      haveNewData=true;
     }
  }
}


///////////////////////////////////////////////////////////////////////SERIAL COMMUNICATION FUNCTIONS END/////////////////////////////////////////////////////////////////////////






////////////////////////////////////////////////////////////////////////////////TIMER////////////////////////////////////////////////////////////////////////////////////////////


bool delayTimes(unsigned long *pasttime,int ms){
  if(millis()-*pasttime>=ms){
    *pasttime=millis();
    return true;
  }
  else{
    return false;
  }
}


//////////////////////////////////////////////////////////////////////////////TIMER/////////////////////////////////////////////////////////////////////////////////////////////






////////////////////////////////////////////////////////////////LORA COMMUNICATON FUNCTIONS STARTS////////////////////////////////////////////////////////////////////////////////


static void LoRaBegin(int spreedingfactor,long bandwith){
  if(!LoRa.begin(915E6)){
    Serial.println("Starting LoRa failed!");
    loraStatus=false;
  }
  if(!(spreedingfactor==-1 && bandwith==-1)){
    LoRa.setSpreadingFactor(spreedingfactor);
    LoRa.setSignalBandwidth(bandwith);
  }
}

static void LoRaSendData(String msg){
  LoRa.beginPacket();
  LoRa.print(msg);
  LoRa.endPacket();
}


////////////////////////////////////////////////////////////////////LORA COMMUNICATON FUNCTIONS ENDS/////////////////////////////////////////////////////////////////////////////






//////////////////////////////////////////////////////////////////////USB FLASH DISK FUNCTIONS STARTS/////////////////////////////////////////////////////////////////////////////


void flashDriveBegin(char * filename){
  flashDrive.init();
  Serial.println("Hello madafaka flash drive initilized");
  if(!checkFlashDrive()){
    Serial.println("Attach flash drive first!");
    while(!checkFlashDrive()){
      ;
    }
    Serial.println("Flash Drive attached");
  }
  flashDeleteFile(filename);
  flashCreateFile(filename);
}

bool checkFlashDrive(){
  
  
  flashDrive.checkIntMessage();  //this fucntion must be called for getdevicestatus function
  if(flashDrive.getDeviceStatus()){
    
    return true;
  } 
  else {
    return false;
  }

  
}

void flashWriteToFile(char* filename,char* message){
  flashDrive.setFileName(filename);
  if(flashDrive.openFile()==ANSW_USB_INT_SUCCESS){
    flashDrive.moveCursor(CURSOREND);
  }
  if(flashDrive.getFreeSectors()){
    flashDrive.writeFile(message,strlen(message));
  }
  else{
    Serial.println("Disk Full");
  }
  flashDrive.closeFile();
}

void flashCreateFile(char* filename){
  flashDrive.setFileName(filename);
  flashDrive.openFile();
  flashDrive.writeFile("Baloon Sensors Data:\n",strlen("Baloon Sensors Data:\n"));
  flashDrive.closeFile();
}

void flashDeleteFile(char* filename){
  flashDrive.setFileName(filename);
  flashDrive.deleteFile();
}

////////////////////////////////////////////////////////////////// USB FLASH DISK FUNCTIONS ENDS ////////////////////////////////////////////////////////////////////////////////






////////////////////////////////////////////////////////////////// GPRS FUNCTIONS STARTS /////////////////////////////////////////////////////////////////////////////////////////


////////////////////////////////////////////////////////////////// GPRS FUNCTIONS ENDS   ////////////////////////////////////////////////////////////////////////////////////////////
